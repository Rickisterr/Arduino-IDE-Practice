/*
Flight Software Code for CSLV

Software's main objective : 
1) Sensor sampling
2) Data Processing and Packet creation
3) Telemetry
4) Launch detection
5) Apogee detection and Drogue Parachute Deployment
6) Main Parachute Deployment
7) Landing Detection
*/

// Changed the main parachute altitude
// Directly using altitude from the array, rather than calculating using pressure
// 

#include <EEPROM.h>

/*
State 0 : Pre launch
State 1 : Ascent --> Kalman Filter
State 2 : Apogee and Parachute Deployment
State 3 : Descent
State 4: Landed
*/


/*
  Sensor Data collection
  Writing in flash
  Telemetry
*/

// Setting up the size of EEPROM

#define EEPROM_SIZE 60

// Declaring required variables



// float altData[] = {100838 , 100827 , 100808 , 100855 , 100825 , 100822 , 100846 , 100856 , 100851 , 100832 , 98533 , 97356 , 96063 ,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 100868 , 100868};
// int timeData[] = {0 , 1 , 2 , 3 , 4 , 5 , 6 , 7 , 8 , 9 , 10 , 11 , 12 ,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 116 , 118};
// // Assuming pitch and roll values will be in degrees
// float pitch[] = {};
// float yaw[] = {};

float timeData[] = {0.00, 0.01, 0.02, 0.03, 0.04, 0.05, 0.06, 0.07, 0.08, 0.09, 0.1, 0.11, 0.12,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 343.98, 344.48};
float altData[] = {0.0000, 0.0003, 0.0026, 0.0100, 0.0252, 0.0496, 0.0835, 0.1265, 0.1787, 0.2402, 0.3111, 0.3912, 0.4806,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 3072.5000,
                   3074.9000, 3077.2000, 3079.6000, 3081.9000, 3084.2000, 3086.5000, 3088.7000, 3090.9000, 3093.1000, 3095.3000, 3097.4000, 3099.6000,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 3.3326, -0.8412};
float vertVelocity[] = {0, 0.054059, 0.41215, 1.0744, 1.9563, 2.9324, 3.8426, 4.7535, 5.6852, 6.6204, 7.5505, 8.4756, 9.3969,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 -9.7645,
                   -9.761, -9.7597, -9.7572, -9.7553, -9.7524, -9.7507, -9.7479, -9.7457, -9.7424, -9.7409, -9.7385, -9.7363,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 -8.3427, -8.3526};
float vertAccel[] = {5.4059, 35.802, 66.212, 88.173, 97.577, 90.984, 91.056, 93.144, 93.485, 92.979, 92.472, 92.101, 92.546,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 0.0025798,
                   0.0058096, 0.0058616, 0.0029766, 0.0090001, 9.07E-04, 0.0055196, 0.0091168, 0.0011806, 0.0053952, 0.0043661, 0.0071309, 0.0033358,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 0.019516, -0.019874};
float totalVelocity[] = {0, 0.054059, 0.41215, 1.0744, 1.9563, 2.9324, 3.8426, 4.7535, 5.6852, 6.6204, 7.5505, 8.4756, 9.3969,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 8.3698, 8.3427};
float totalAccel[] = {5.4059, 35.802, 66.212, 88.173, 97.577, 90.984, 91.056, 93.144, 93.485, 92.979, 92.472, 92.101, 92.546,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 0.21389,
                     0.17455, 0.12079, 0.16175, 0.16434, 0.17498, 0.0061791, 0.028084, 0.022257, 0.085582, 0.023458, 0.22355, 0.078195,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 0.63277, 0.031522};
// float rollRate[] = {0.0 , 0.0 , 0.0 , 0.0 , 0.0 , 0.0 , 0.0 , 0.0 , 0.0 , 0.0 , 0.0 , 0.0 , 0.0 ,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 -4.02e-05 , nan , nan , nan , nan , nan , nan , nan , nan , nan , nan , nan , nan , nan , nan , nan , nan , nan , nan , nan , nan , nan , nan , nan , nan , nan , nan , nan , nan , nan , nan , nan , nan , nan , nan , nan , nan , nan , nan , nan , nan , nan , nan , nan , nan , nan , nan , nan , nan , nan , nan , nan , nan , nan , nan , nan , nan , nan , nan , nan , nan , nan , nan , nan , nan , nan , nan , nan , nan , nan , nan , nan , nan , nan , nan , nan , nan , nan , nan , nan , nan , nan , nan , nan , nan , nan , nan , nan , nan , nan , nan , nan , nan , nan , nan , nan , nan , nan , nan , nan , nan , nan , nan , nan , nan , nan , nan , nan , nan , nan , nan , nan , nan , nan , nan , nan , nan , nan , nan , nan , nan , nan , nan , nan , nan , nan , nan , nan , nan , nan , nan , nan , nan , nan , nan , nan , nan , nan , nan , nan , nan , nan , nan , nan , nan , nan , nan , nan , nan , nan , nan , nan , nan , nan , nan , nan , nan , nan , nan , nan , nan , nan , nan , nan , nan , nan , nan , nan , nan , nan , nan , nan , nan , nan , nan , nan , nan , nan , nan , nan , nan , nan , nan , nan , nan , nan , nan , nan , nan , nan , nan , nan , nan , nan , nan , nan , nan , nan}
// float pitchRate[] = {0.0 , 0.0 , 0.0 , 0.0 , 0.0 , 0.0 , 0.0 , 0.0 , 0.0 , 0.0 , 0.0 , 0.0 , 0.0 ,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 25.508 , nan , nan , nan , nan , nan , nan , nan , nan , nan , nan , nan , nan , nan , nan , nan , nan , nan , nan , nan , nan , nan , nan , nan , nan , nan , nan , nan , nan , nan , nan , nan , nan , nan , nan , nan , nan , nan , nan , nan , nan , nan , nan , nan , nan , nan , nan , nan , nan , nan , nan , nan , nan , nan , nan , nan , nan , nan , nan , nan , nan , nan , nan , nan , nan , nan , nan , nan , nan , nan , nan , nan , nan , nan , nan , nan , nan , nan , nan , nan , nan , nan , nan , nan , nan , nan , nan , nan , nan , nan , nan , nan , nan , nan , nan , nan , nan , nan , nan , nan , nan , nan , nan , nan , nan , nan , nan , nan , nan , nan , nan , nan , nan , nan , nan , nan , nan , nan , nan , nan , nan , nan , nan , nan , nan , nan , nan , nan , nan , nan , nan , nan , nan , nan , nan , nan , nan , nan , nan , nan , nan , nan , nan , nan , nan , nan , nan , nan , nan , nan , nan , nan , nan , nan , nan , nan , nan , nan , nan , nan , nan , nan , nan , nan , nan , nan , nan , nan , nan , nan , nan , nan , nan , nan , nan , nan , nan , nan , nan , nan , nan , nan , nan , nan , nan , nan , nan , nan , nan , nan , nan , nan , nan , nan , nan , nan , nan , nan};
// float yawRate[] = {0.0 , 0.0 , 0.0 , 0.0 , 0.0 , 0.0 , 0.0 , 0.0 , 0.0 , 0.0 , 0.0 , 0.0 , 0.0 ,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 -0.10181 , nan , nan , nan , nan , nan , nan , nan , nan , nan , nan , nan , nan , nan , nan , nan , nan , nan , nan , nan , nan , nan , nan , nan , nan , nan , nan , nan , nan , nan , nan , nan , nan , nan , nan , nan , nan , nan , nan , nan , nan , nan , nan , nan , nan , nan , nan , nan , nan , nan , nan , nan , nan , nan , nan , nan , nan , nan , nan , nan , nan , nan , nan , nan , nan , nan , nan , nan , nan , nan , nan , nan , nan , nan , nan , nan , nan , nan , nan , nan , nan , nan , nan , nan , nan , nan , nan , nan , nan , nan , nan , nan , nan , nan , nan , nan , nan , nan , nan , nan , nan , nan , nan , nan , nan , nan , nan , nan , nan , nan , nan , nan , nan , nan , nan , nan , nan , nan , nan , nan , nan , nan , nan , nan , nan , nan , nan , nan , nan , nan , nan , nan , nan , nan , nan , nan , nan , nan , nan , nan , nan , nan , nan , nan , nan , nan , nan , nan , nan , nan , nan , nan , nan , nan , nan , nan , nan , nan , nan , nan , nan , nan , nan , nan , nan , nan , nan , nan , nan , nan , nan , nan , nan , nan , nan , nan , nan , nan , nan , nan , nan , nan , nan , nan , nan , nan , nan , nan , nan , nan , nan , nan , nan , nan , nan , nan , nan , nan};
// For apogee detection, convert acceleration values to velocity and check if velocity is less than 10 and greater than -10 lets say
// Along with altitude thing ofcourse. And a timer.


/*
Altitude Values : 
0.0,0.9202644672168259,2.5100036771628442,-1.4220670346885589,1.0875940133600048,1.3385933718521181,-0.6692321954687719,-1.5057119923021545,-1.0874804887248768,0.5019523594902187,194.63822276207827,295.4518237441779,407.345184087121,496.3018946452127,568.5193483993289,623.4613937085695,665.1292679138008,695.5072504443071,713.2395044181319,702.3994833178807,684.5071802016164,670.0372589092927,656.6573536927782,638.4886268788117,627.1939197092433,611.6506674251812,594.0928929477748,580.7230024836161,563.3945954662482,551.387936279771,534.989715708775,521.2564860414172,505.608861362506,489.7218524223157,472.89606682173144,461.3442522677561,450.8538227605676,437.930305953208,427.7251890610128,414.83059474402376,404.7352708573366,394.04151945489247,382.1436159380127,371.21310469037473,361.93991698760055,348.9541151196259,340.9975544101011,334.8613489505786,329.5059492091649,320.61520174213996,316.47455006143184,309.5771450318982,299.3257549230552,292.00954634630364,288.13835227781544,278.8533892346639,270.95053918563104,263.5685428150179,258.76448867850195,253.79120908317162,244.02309525836844,236.48909011980138,231.6975735868462,223.48869545485783,215.54253918971287,207.7731587309845,200.6918732707803,197.7072377850312,186.88448097840734,180.49838790649227,174.54157845536017,166.63281700130284,160.768918088433,151.42751754672412,147.94787186277682,140.22891938171722,131.0754033868091,124.30021784192361,119.39096976224572,109.49488450118677,104.08562589012408,98.34137148206415,89.3934181448266,84.75364489307262,78.26143837696542,67.98337542260076,63.85815786169676,54.93981045726152,48.71832210353146,43.088559388532055,36.45439061942801,28.230533394949425,19.677901783860786,14.398901004633398,5.104309622869435,-1.5057119923021545,0.7529376085825801,-1.84028510762128,-0.8365335276307118,0.25097315673435316,-2.425762207987885,-1.2547751048361389,0.6692751870480862,0.0,0.6692751870480862,-2.3421246364935056,-0.2509671110475109,1.5059296371712028,-1.5057119923021545,0.5019523594902187,-2.5093991080750455,-2.5093991080750455,-2.5093991080750455,-2.5093991080750455,-2.5093991080750455,-2.5093991080750455,-2.5093991080750455
*/

int count = 0;
unsigned long startMission;

// Creating a STRUCT for current data
// Using 52 bytes. Putting the size of EEPROM as 60 bytes just in case
struct currentData
{
  int state; //4 bytes
  float alt; //4 bytes
  float accelX; //4 bytes
  float accelY; //4 bytes
  float accelZ; //4 bytes
  float gyroX; //4 bytes
  float gyroY; //4 bytes
  float gyroZ; //4 bytes
  float magnetoX; //4 bytes
  float magnetoY; //4 bytes
  float magnetoZ; //4 bytes
  float velocityVertical; //4 bytes
  float missionTime; // 4 bytes
};


// Declaring an instance of the STRUCT currentData
struct currentData curDataStruct;


// Declaring and Initialiing required variables
int state = 0;
float alt = 0.0;
float accelX = 0.0;
float accelY = 0.0;
float accelZ = 0.0;
float gyroX = 0.0;
float gyroY = 0.0;
float gyroZ = 0.0;
float magnetoX = 0.0;
float magnetoY = 0.0;
float magnetoZ = 0.0;
float missionTime = 0;
float velocityVertical = 0.0;
float accelerationVertical = 0.0;



// Creating Functions for required functionality

// Function to get data from sensors, process it and store it in EEPROM, Flash/SD
// Keep calling this function in every state
void getAndSendData()
{
  // Get all sensor readings 
  // Reading validation
  // Data Packet generation
  // Store in Flash
  // Send to Ground Station
  Serial.println("Get and Send Data Function Called");
  Serial.println(count);
  
  missionTime = timeData[count];
  alt = altData[count];
  velocityVertical = vertVelocity[count];
  accelerationVertical = vertAccel[count];
  // International Barometric Formula : 1013.25hPa is the reference pressure at sea level
  // 44330 * [1 - (P/p0)^(1/5.255) ] 
  // alt = (44330 * (1 - pow((alt/100838.00),(1/5.255))));
  count++;
  curDataStruct.alt = alt;
  curDataStruct.missionTime = missionTime;
  curDataStruct.velocityVertical = velocityVertical;
  curDataStruct.accelY = accelerationVertical;

  EEPROM.put(0,curDataStruct);

   Serial.println(curDataStruct.alt);
  Serial.println(curDataStruct.missionTime);
}

// Function running STATE 0 Code : PRE-LAUNCH
void state0()
{
  Serial.println("State 0 called(Pre-Launch Condition)");
  curDataStruct.state = 0;
//  EEPROM.put(0,curDataStruct);

  int flag = 0; // To signify the condition that will make the code transition from state 0 to 1
  int countAltitude = 0;
  int countAcceleration = 0;
  int countVelocity = 0;
  do //Random condition. This condition needs to be changed. Just an initial condition to create the structure of the code
  {
    getAndSendData();
  
    struct currentData temp;
    temp = curDataStruct;
    alt = temp.alt;
    state = temp.state;
    missionTime = temp.missionTime;
    velocityVertical = temp.velocityVertical;
    accelerationVertical = temp.accelY;    
    EEPROM.get(0,temp);
    Serial.print("State : ");
    Serial.println(temp.state);
    Serial.print("alt : ");
    Serial.println(alt);
    Serial.println(temp.alt);
    Serial.print("Mission Time : ");
    Serial.println(temp.missionTime);
    Serial.print("Vertical Velocity : ");
    Serial.println(temp.velocityVertical);
    Serial.print("Vertical Acceleration : ");
    Serial.println(temp.accelY);
    if(alt > 2)
    {
      if(countAltitude > 5)
      {
      flag = 1;
      startMission = millis();
      }
      countAltitude += 1;
    }
    else
    {
      if(countAltitude > 0)
      {
        countAltitude -= 1;
      }
    }

    if(temp.velocityVertical > 5)
    {
      countVelocity +=1;         
    }
    else
    {
      if(countVelocity > 0)
      {      
        countVelocity -= 1;
      }
    }

    // Here we are going to use the equation, and check for the threshold.
    float altitudeWeight = 0.5;
    float velocityWeight = 0.5;

    float calculation = altitudeWeight * countAltitude + velocityWeight * countVelocity;

    Serial.print("Calculation solution : ");
    Serial.println(calculation);   

    // Just with altitude > 2 5 times, it takes 15-20 value of calculation variable to move to State 1  

    delay(1000);
  }while(flag == 0); // Accelerometer says there is acceleration + altitude is > 5 or 10 for 5 readings
// Vertical acceleration is greater than 0,  means there is liftoff.  

  // Conditions : If alt > 0 for 5 values, then lift off has occured.(BMP condition). Using IMU, If acceleration has occured(For 5 values), that's a condition. 
  //Using GPS, If the latitude/ longitude has changed(For 5 values), that is a condition. 
  
  // We can create an equation out of these. Giving weights to each of the condition. AX + BY + CZ. A, B, C will be coefficients, that can be 1, if the 
  // condition has successfully occured and 0 if not. X, Y, Z will be the weight we provide each condition. We will check with a threshold value for the equation. 
  //If our calculated value if greater than threshold, then condition has occured

  // Put a condition for state transition
  state1();
}
// Function running STATE 1 Code : ASCENT
void state1()
{
  Serial.println("State 1 called(Ascent Condition)");
  curDataStruct.state = 1;
//  EEPROM.put(0, curDataStruct);

  int flag = 0;

  float prevalt = 0.0;

  int altitudeCounter = 0;
  int velocityCounter = 0;
  int accelerationCounter = 0;
    
  do
  {
  
    getAndSendData();
  
    struct currentData temp;
    temp = curDataStruct;
//    alt = temp.alt;
//    state = temp.state;
//    missionTime = temp.missionTime;
    
    EEPROM.get(0,temp);
    Serial.print("State : ");
    Serial.println(temp.state);
    Serial.print("alt : ");
    Serial.println(temp.alt);
    Serial.print("Mission Time : ");
    Serial.println(temp.missionTime);
    Serial.print("Vertical Velocity : ");
    Serial.println(temp.velocityVertical);
    Serial.print("Vertical Acceleration : ");
    Serial.println(temp.accelY);
    /*if(temp.alt < prevalt)
    {
      Serial.print("alt maybe decresing : ");
      Serial.print(temp.alt);
      Serial.print(" , ");
      Serial.println(prevalt);
      altitudeCounter++;
      if(altitudeCounter >= 5)
      {
        flag = 1;
      }

      delay(1000);
    }
    else
    {
      if(altitudeCounter > 0)
      {
        altitudeCounter -= 1;
      }
    }

    if(temp.velocityVertical < 5)
    {
        velocityCounter += 1;
    }
    else
    {
      if(velocityCounter > 0)
      {
        velocityCounter -= 1;
      }  
    }

    // Here we are going to use the equation, and check for the threshold.
    float altitudeWeight = 0.5;
    float velocityWeight = 0.5;

    float calculation = altitudeWeight * altitudeCounter + velocityWeight * velocityCounter;

    // With just the altitude condition, calculation was about 10-12 value, before it transferred to the next stage.

    Serial.print("Calculation solution : ");
    Serial.println(calculation);   
    
    prevalt = temp.alt;*/
    delay(1000);
    if((millis() - startMission) > 35000){
      flag = 1;
    }

  }while(flag == 0); // Previous Altitude is greater than the current altitude for 5 readings, Velocity is near 0(-5 to +5)for 5 readings
                      // We can try adding tilt detection, but it is risky. It doesn't seem reliable. Also a t2a timer.

  // Apogee detection condition : If altitude < prevAltitude for 5 values, If there is a tilt greater than a thrershold value, If velocity = 0 or close to 0(-1 to 1) for 5 values, If acceleration is -9.8 for 
  // 5 values, Or if velocity vector is -ve for 5 values. 
  
  //We can create an equation out of these. Giving weights to each of the condition. AX + BY + CZ. A, B, C will be coefficients, that can be 1, if the 
  // condition has successfully occured and 0 if not. X, Y, Z will be the weight we provide each condition. We will check with a threshold value for the equation. If our calculated value if greater than threshold, then condition has occured
  // Having a seperate mission timer running checking for a simulated t2a, if no condition is approved by anything, then atleast this pre-calculated t2a, will set off the pyro charge. We can also add remote detonation of pyro charge
  // From ground station
  
  // Put a condition here for state transition
  state2();
}


// Function running STATE 2 Code : APOGEE(DEPLOYING DROGUE PARACHUTES)
void state2()
{
  Serial.println("State 2 called(Apogee Condition)");
  curDataStruct.state = 2;
//  EEPROM.put(0, curDataStruct);

  int c = 0;

  Serial.println("Recovery Ejection charge being set off");

  // Setting off the pyro charge. Turning the relay off and on 5 times.

  while(c < 5)
  {
    getAndSendData();
  
    struct currentData temp;
    temp = curDataStruct;
    alt = temp.alt;
    state = temp.state;
    missionTime = temp.missionTime;
     
    EEPROM.get(0,temp);
    Serial.print("State : ");
    Serial.println(temp.state);
    Serial.print("alt : ");
    Serial.println(temp.alt);
    Serial.print("Mission Time : ");
    Serial.println(temp.missionTime);

    Serial.println("Relay being turned on");
    delay(1000);
    Serial.println("Relay being turned off");
    delay(1000);

    c++;
  }

  // Put a condition here for state transition
  state3();
}

// Function running STATE 3 Code : DESCENT
void state3()
{
  Serial.println("State 3 called(Descent Condition)");
  curDataStruct.state = 3;
//  EEPROM.put(0, curDataStruct);

  int altitudeCount = 0;
  int flag = 0;
  do
  {
    getAndSendData();
  
    struct currentData temp;
    temp = curDataStruct;
    alt = temp.alt;
    state = temp.state;
    missionTime = temp.missionTime;
    EEPROM.get(0,temp);
    Serial.print("State : ");
    Serial.println(temp.state);
    Serial.print("alt : ");
    Serial.println(temp.alt);
    Serial.print("Mission Time : ");
    Serial.println(temp.missionTime);

    if(alt < 457.20)
    {
      Serial.print(alt);
      Serial.print(" , ");
      Serial.println("Less than 457.2m");
      if(altitudeCount >= 5)
      {
        flag = 1;
      }
      altitudeCount++;
      
    }
    else
    {
      altitudeCount = 0;
    }

    delay(2000);
  }while(flag == 0); //Altitude is less than 500m for 5 consecutive readings and a t2mainparachutedeployment timer
  // We can add a t2MainParachuteDeployment, in this using which we can deploy pyro charges for main parachute if nothing works. 
  // Can also add remote detonation of Pyro charges for Main parachute Deployment
  // Put a condition here for state transition
  state4();
}

// Function running STATE 4 Code : LANDING
void state4()
{
  Serial.println("State 4 called(Landed Condition)");
  curDataStruct.state = 4;
//  EEPROM.put(0, curDataStruct);

  int flag = 0;
  int altitudeCounter = 0;
  int velocityCounter = 0;
  int accelerationCounter = 0;

  do
  {
    getAndSendData();
  
    struct currentData temp;
    temp = curDataStruct;
    alt = temp.alt;
    state = temp.state;
    missionTime = temp.missionTime;
    EEPROM.get(0,temp);
    Serial.print("State : ");
    Serial.println(temp.state);
    Serial.print("alt : ");
    Serial.println(temp.alt);
    Serial.print("Mission Time : ");
    Serial.println(temp.missionTime);
    Serial.print("Vertical Velocity : ");
    Serial.println(temp.velocityVertical);
    Serial.print("Vertical Acceleration : ");
    Serial.println(temp.accelY);


    // If 5 readings are constant, then  the rocket has landed
    if(alt <= 5)
    {
      altitudeCounter++;
      if(altitudeCounter >= 5)
      {
        flag = 1;
      }
      else
      {
        if(altitudeCounter > 0)
        {
        altitudeCounter -= 1;
        }        
      }
    }
    if(temp.velocityVertical < 2 && temp.velocityVertical > -2)
    {
        velocityCounter += 1;
    }
    else
    {
      if(velocityCounter > 0)
      {
        velocityCounter -= 1;
      }  
    }

    // Here we are going to use the equation, and check for the threshold.
    float altitudeWeight = 0.5;
    float velocityWeight = 0.5;

    float calculation = altitudeWeight * altitudeCounter + velocityWeight * velocityCounter;

    // With just the altitude condition, calculation was about 10-12 value, before it transferred to the next stage.

    Serial.print("Calculation solution : ");
    Serial.println(calculation);   

    delay(1000);
  }while(flag == 0); // If altitude is less than 5 or 10m for 5 readings and Velocity is 0, Acceleration is around -9.8m/s^2
  // If altitude is between -5 and +5 m for 5-10 consecutive values, If velocity is between the range of a threshold velocity range for 
  // 5-10 consecutive values. If the roll/pitch/yaw values are constant 
  // for 5-10 consecutive values. If calculated t2L has been reached. 
  Serial.println("Rocket has landed");
  Serial.println("Turning on the buzzer");
}

// Function to Calibrate Sensors
void calibrateSensors()
{
  // Function to calibrate all the sensors
  Serial.println("Calibrating Sensors");
}

// Initial Setup of the Flight Computer...
// Figuring out current State of the flight. Calibrating sensors and performing the particular state code function accordingly.
void setup() {
  // Read from EEPROM and go to state
  // If state is 0, then calibrate, else go to state
  delay(5000);
  Serial.begin(9600);
  // EEPROM.begin(EEPROM_SIZE);

  Serial.println("EEPROM Ready....");
  
  struct currentData stateStruct;
  EEPROM.get(0,stateStruct);
  
  if(stateStruct.state == -1) // Either -1 or nan, check once.
  {
    calibrateSensors();
    state0();
  }
  else if(stateStruct.state == 0){
    state0();
    }
  else if(stateStruct.state == 1)
  {
    state1();
  }
  else if(stateStruct.state == 2)
  {
    state2();
  }
  else if(stateStruct.state == 3)
  {
    state3();
  }
  else if(stateStruct.state == 4)
  {
    state4();
  }
}

void loop() {
  // put your main code here, to run repeatedly:

}
